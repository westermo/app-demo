## Config.in
```kconfig
config DEMO_PLATFORM
	string
	default "coronet" if BR2_powerpc
	default "dagger"  if BR2_arm
	default "zero"    if BR2_x86_64
	default BR2_ARCH

config DEMO_VENDOR_ID
	string "Single word lower-case identifier for the operating system"
	default "backbone"
	help
	  A lower-case string (no spaces or other characters outside of
          0–9, a–z, '.', '_' and '-') identifying the operating system,
          excluding any version information and suitable for processing
          by scripts or usage in generated filenames.

	  Used for identifying the OS, e.g. as ID in /etc/os-release and
	  in the generated image name: ID-TYPE-PLAT.img

config DEMO_VENDOR_NAME
	string "String identifier for the operating system"
	default "Backbone"
	help
	  Used for identifying the OS, e.g. as NAME in /etc/os-release

config DEMO_VENDOR_DESC
	string "Pretty operating system name, format for presentation to user"
	default "Backbone Demo"
	help
	  Used for identifying the OS, e.g. as PRETTY_NAME in /etc/os-release

config DEMO_VENDOR_HOME
	string "Internet URL for the homepage of the operating system"
	default "https://github.com/westermo/app-demo/"
	help
	  Used for identifying the OS, e.g. as HOME_URL in /etc/os-release

config DEMO_VENDOR_VERSION
	string "Version of operating system, may be a script with ``"
	default "`$BR2_EXTERNAL_NETBOX_PATH/bin/mkversion`"
	help
	   A lower-case string (no spaces or other characters outside of
           0–9, a–z, '.', '_' and '-') identifying the operating system
           version, excluding any OS name information or release code
           name, and suitable for processing by scripts or usage in
           generated filenames.

	   Used for VERSION and VERSION_ID in /etc/os-release

menu "Packages"

source "$BR2_EXTERNAL_DEMO_PATH/package/Config.in"

endmenu
```

## configs/backbone_zero_defconfig
```kconfig
BR2_x86_64=y
BR2_CCACHE=y
BR2_CCACHE_DIR="$(BR2_EXTERNAL_DEMO_PATH)/.buildroot-ccache"
BR2_ENABLE_DEBUG=y
BR2_TOOLCHAIN_EXTERNAL=y
BR2_TOOLCHAIN_EXTERNAL_DOWNLOAD=y
BR2_TOOLCHAIN_EXTERNAL_URL="https://github.com/myrootfs/crosstool-ng/releases/download/troglobit%2F7.3.0-1/$(ARCH)-unknown-linux-gnu-7.3.0-1.tar.xz"
BR2_TOOLCHAIN_EXTERNAL_CUSTOM_PREFIX="$(ARCH)-unknown-linux-gnu"
BR2_TOOLCHAIN_EXTERNAL_GCC_7=y
BR2_TOOLCHAIN_EXTERNAL_HEADERS_4_15=y
BR2_TOOLCHAIN_EXTERNAL_CUSTOM_GLIBC=y
BR2_TOOLCHAIN_EXTERNAL_GDB_SERVER_COPY=y
BR2_TARGET_GENERIC_HOSTNAME="backbone"
BR2_TARGET_GENERIC_ISSUE="Backbone Demo"
BR2_ROOTFS_OVERLAY="$(BR2_EXTERNAL_DEMO_PATH)/board/demo/backbone/rootfs"
BR2_ROOTFS_POST_BUILD_SCRIPT="$(BR2_EXTERNAL_DEMO_PATH)/board/demo/backbone/post-build.sh"
BR2_ROOTFS_POST_IMAGE_SCRIPT="$(BR2_EXTERNAL_DEMO_PATH)/board/common/post-image.sh"
BR2_ROOTFS_POST_SCRIPT_ARGS=""
BR2_PACKAGE_DNSMASQ=y
BR2_PACKAGE_DROPBEAR=y
BR2_PACKAGE_LLDPD=y
BR2_PACKAGE_SOCAT=y
BR2_PACKAGE_TCPDUMP=y
BR2_TARGET_ROOTFS_SQUASHFS=y
# BR2_TARGET_ROOTFS_TAR is not set
BR2_PACKAGE_BACKBONE=y
```

## configs/demo_configuration_defconfig
```kconfig
#BR2_x86_64=y
BR2_powerpc=y
BR2_powerpc_e5500=y
BR2_ENABLE_DEBUG=y
BR2_TOOLCHAIN_EXTERNAL=y
BR2_TOOLCHAIN_EXTERNAL_DOWNLOAD=y
BR2_TOOLCHAIN_EXTERNAL_URL="https://github.com/myrootfs/crosstool-ng/releases/download/troglobit%2F7.3.0-1/$(ARCH)-unknown-linux-gnu-7.3.0-1.tar.xz"
BR2_TOOLCHAIN_EXTERNAL_CUSTOM_PREFIX="$(ARCH)-unknown-linux-gnu"
BR2_TOOLCHAIN_EXTERNAL_GCC_7=y
BR2_TOOLCHAIN_EXTERNAL_HEADERS_4_15=y
BR2_TOOLCHAIN_EXTERNAL_CUSTOM_GLIBC=y
BR2_TOOLCHAIN_EXTERNAL_GDB_SERVER_COPY=y
BR2_TARGET_GENERIC_HOSTNAME="configuration"
BR2_TARGET_GENERIC_ISSUE="Configuration Demo"
BR2_ROOTFS_OVERLAY="$(BR2_EXTERNAL_DEMO_PATH)/board/demo/configuration/rootfs"
BR2_ROOTFS_POST_BUILD_SCRIPT="$(BR2_EXTERNAL_DEMO_PATH)/board/demo/configuration/post-build.sh"
BR2_PACKAGE_DNSMASQ=y
BR2_PACKAGE_DROPBEAR=y
BR2_PACKAGE_LLDPD=y
# BR2_PACKAGE_LLDPD_CDP is not set
# BR2_PACKAGE_LLDPD_FDP is not set
# BR2_PACKAGE_LLDPD_EDP is not set
# BR2_PACKAGE_LLDPD_SONMP is not set
# BR2_PACKAGE_LLDPD_LLDPMED is not set
# BR2_PACKAGE_LLDPD_DOT1 is not set
# BR2_PACKAGE_LLDPD_DOT3 is not set
BR2_PACKAGE_SOCAT=y
BR2_PACKAGE_TCPDUMP=y
BR2_TARGET_ROOTFS_SQUASHFS=y
# BR2_TARGET_ROOTFS_TAR is not set
BR2_PACKAGE_CONFIGURATION=y
```

## configs/led-relay_dagger_defconfig
```kconfig
BR2_arm=y
BR2_cortex_a9=y
BR2_ENABLE_DEBUG=y
BR2_TOOLCHAIN_EXTERNAL=y
BR2_TOOLCHAIN_EXTERNAL_DOWNLOAD=y
BR2_TOOLCHAIN_EXTERNAL_URL="https://github.com/myrootfs/crosstool-ng/releases/download/troglobit%2F7.3.0-1/$(ARCH)-unknown-linux-gnu-7.3.0-1.tar.xz"
BR2_TOOLCHAIN_EXTERNAL_CUSTOM_PREFIX="$(ARCH)-unknown-linux-gnu"
BR2_TOOLCHAIN_EXTERNAL_GCC_7=y
BR2_TOOLCHAIN_EXTERNAL_HEADERS_4_15=y
BR2_TOOLCHAIN_EXTERNAL_CUSTOM_GLIBC=y
BR2_TOOLCHAIN_EXTERNAL_GDB_SERVER_COPY=y
BR2_TARGET_GENERIC_HOSTNAME="led-relay"
BR2_TARGET_GENERIC_ISSUE="LED and Relay Demo"
BR2_ROOTFS_OVERLAY="$(BR2_EXTERNAL_DEMO_PATH)/board/demo/led-relay/rootfs"
BR2_ROOTFS_POST_BUILD_SCRIPT="$(BR2_EXTERNAL_DEMO_PATH)/board/demo/led-relay/post-build.sh"
BR2_ROOTFS_POST_IMAGE_SCRIPT="$(BR2_EXTERNAL_DEMO_PATH)/board/common/post-image.sh"
BR2_ROOTFS_POST_SCRIPT_ARGS=""
BR2_PACKAGE_DNSMASQ=y
BR2_PACKAGE_DROPBEAR=y
BR2_PACKAGE_LLDPD=y
BR2_TARGET_ROOTFS_SQUASHFS=y
BR2_PACKAGE_LED_RELAY=y
```

## configs/led-relay_zero_defconfig
```kconfig
BR2_x86_64=y
BR2_x86_corei7=y

BR2_DL_DIR="$(BR2_EXTERNAL_NETBOX_PATH)/dl"
BR2_CCACHE=y
BR2_CCACHE_DIR="$(BR2_EXTERNAL_NETBOX_PATH)/.buildroot-ccache"
BR2_ENABLE_DEBUG=y
BR2_GLOBAL_PATCH_DIR="$(BR2_EXTERNAL_NETBOX_PATH)/patches"
BR2_TARGET_GENERIC_HOSTNAME="$(NETBOX_PLAT)"
BR2_TARGET_GENERIC_ISSUE="NetBox - The Networking Toolbox"
BR2_INIT_FINIT=y
BR2_ROOTFS_OVERLAY="$(BR2_EXTERNAL_NETBOX_PATH)/board/common/rootfs $(BR2_EXTERNAL_NETBOX_PATH)/board/app/rootfs "
BR2_ROOTFS_POST_BUILD_SCRIPT="$(BR2_EXTERNAL_NETBOX_PATH)/board/common/post-build.sh"
BR2_ROOTFS_POST_IMAGE_SCRIPT="$(BR2_EXTERNAL_NETBOX_PATH)/board/common/post-image.sh $(BR2_EXTERNAL_NETBOX_PATH)/board/$(NETBOX_PLAT)/post-image.sh "
BR2_PACKAGE_BUSYBOX_CONFIG="$(BR2_EXTERNAL_NETBOX_PATH)/board/common/busybox.config"
BR2_PACKAGE_BUSYBOX_SHOW_OTHERS=y
BR2_TARGET_ROOTFS_SQUASHFS=y
BR2_PACKAGE_HOST_GENIMAGE=y
BR2_PACKAGE_HOST_GENEXT2FS=y
BR2_PACKAGE_HOST_SQUASHFS=y
# BR2_TARGET_ROOTFS_TAR is not set

# BR2_TARGET_GENERIC_REMOUNT_ROOTFS_RW is not set
# APP profile selects the following packages
BR2_PACKAGE_BUSYBOX_CONFIG_FRAGMENT_FILES="$(BR2_EXTERNAL_NETBOX_PATH)/board/app/busybox.fragment"
NETBOX_TYPE_APP=y
BR2_PACKAGE_DROPBEAR=y
BR2_PACKAGE_TCPDUMP=y
BR2_TOOLCHAIN_EXTERNAL=y
BR2_TOOLCHAIN_EXTERNAL_BOOTLIN=y
BR2_TOOLCHAIN_EXTERNAL_BOOTLIN_X86_64_CORE_I7_GLIBC_STABLE=y
BR2_TOOLCHAIN_EXTERNAL_GDB_SERVER_COPY=y


BR2_DL_DIR="$(BR2_EXTERNAL_DEMO_PATH)/dl"
BR2_CCACHE_DIR="$(BR2_EXTERNAL_DEMO_PATH)/.buildroot-ccache"





BR2_GLOBAL_PATCH_DIR="$(BR2_EXTERNAL_NETBOX_PATH)/patches $(BR2_EXTERNAL_DEMO_PATH)/patches"

BR2_ROOTFS_OVERLAY="$(BR2_EXTERNAL_NETBOX_PATH)/board/common/rootfs $(BR2_EXTERNAL_NETBOX_PATH)/board/app/rootfs $(BR2_EXTERNAL_DEMO_PATH)/board/demo/$(DEMO_VENDOR_ID)/rootfs "

BR2_ROOTFS_POST_BUILD_SCRIPT="$(BR2_EXTERNAL_NETBOX_PATH)/board/common/post-build.sh $(BR2_EXTERNAL_DEMO_PATH)/board/common/post-build.sh $(BR2_EXTERNAL_DEMO_PATH)/board/demo/$(DEMO_VENDOR_ID)/post-build.sh"
BR2_ROOTFS_POST_IMAGE_SCRIPT="$(BR2_EXTERNAL_NETBOX_PATH)/board/common/post-image.sh $(BR2_EXTERNAL_NETBOX_PATH)/board/$(NETBOX_PLAT)/post-image.sh $(BR2_EXTERNAL_DEMO_PATH)/board/common/post-image.sh $(BR2_EXTERNAL_DEMO_PATH)/board/demo/$(DEMO_VENDOR_ID)/post-image.sh"

BR2_TARGET_GENERIC_HOSTNAME="led-relay"





BR2_PACKAGE_DNSMASQ=y
BR2_PACKAGE_DROPBEAR=y
BR2_PACKAGE_LLDPD=y
BR2_PACKAGE_SOCAT=y
BR2_PACKAGE_TCPDUMP=y
BR2_TARGET_ROOTFS_SQUASHFS=y
BR2_PACKAGE_LED_RELAY=y

BR2_TARGET_GENERIC_ISSUE="Westermo Application"

NETBOX_VENDOR_ID="led-relay"
NETBOX_VENDOR_NAME="LED-Relay Application"
NETBOX_VENDOR_DESC="Application Demo - Westermo LXC container"
NETBOX_VENDOR_HOME="https://github.com/westermo/app-demo/"
NETBOX_VENDOR_VERSION="`$BR2_EXTERNAL_NETBOX_PATH/bin/mkversion $BR2_EXTERNAL_DEMO_PATH`"
```

## package/Config.in
```kconfig
source "$BR2_EXTERNAL_DEMO_PATH/package/backbone/Config.in"
source "$BR2_EXTERNAL_DEMO_PATH/package/leds/Config.in"
source "$BR2_EXTERNAL_DEMO_PATH/package/dhcp-boot/Config.in"
```

## package/backbone/Config.in
```kconfig
config BR2_PACKAGE_BACKBONE
	bool "backbone"
	select BR2_PACKAGE_JANSSON
	select BR2_PACKAGE_LIBEV
	select BR2_PACKAGE_LIBTEAM
	select BR2_PACKAGE_NFTABLES
	select BR2_PACKAGE_SMCROUTE
	select BR2_PACKAGE_IPROUTE2
	help
	  Given four ports, n{1,2} and s{1, 2}, creates two link
	  aggregates, north and south, using a custom LACP-like
	  protocol. The LAGs are bridged and routes are setup in
	  accordance with the config file in
	  /etc/backbone.json. Backbone traffic is then routed to/from
	  the host via the lan interface.
```

## package/configuration/Config.in
```kconfig
config BR2_PACKAGE_CONFIGURATION
	bool "configuration"
	select BR2_PACKAGE_JANSSON
	select BR2_PACKAGE_LIBEV
	select BR2_PACKAGE_LIBTEAM
	select BR2_PACKAGE_NFTABLES
	select BR2_PACKAGE_SMCROUTE
	select BR2_PACKAGE_IPROUTE2
	help
	  Fill in some help text here.
```

## package/dhcp-boot/Config.in
```kconfig
config BR2_PACKAGE_DHCP_BOOT
	bool "dhcp-boot"
	help
	  Demo of how to create a container application that serves the
	  WeOS host system with a startup-config at system bootstrap.

	  The container runs dnsmasq to hand out a DHCP lease with a
	  boot file and TFTP server to the host system.  See the README
	  for more information and how to configure the WeOS host.
```

## package/led-relay/Config.in
```kconfig
config BR2_PACKAGE_LED_RELAY
	bool "led-relay"
	help
	  LED demo application. 
	  This demonstrates how a container application can be used 
	  to control one or more LEDs shared by the host system.
```

## package/leds/Config.in
```kconfig
config BR2_PACKAGE_LEDS
	bool "LED Demo"
	select BR2_PACKAGE_LIBEV
	help
	  LED Demo application. This demonstrates how a container application 
	  can be used to control one or more LEDs shared by the host system.
```
